## sdkconfig.defaults
```kconfig
#
# This is sdk configuration for the ESP-IDF starter project
# Documentation: https://docs.espressif.com/projects/arduino-esp32/en/latest/esp-idf_component.html
#

# mbedTLS
CONFIG_MBEDTLS_PSK_MODES=y
CONFIG_MBEDTLS_KEY_EXCHANGE_PSK=y
CONFIG_MBEDTLS_KEY_EXCHANGE_ECDHE_PSK=y
CONFIG_MBEDTLS_KEY_EXCHANGE_RSA_PSK=y

# Partition Table
CONFIG_PARTITION_TABLE_CUSTOM=y
CONFIG_PARTITION_TABLE_CUSTOM_FILENAME="extras/partitions-4mb.csv"
CONFIG_PARTITION_TABLE_FILENAME="extras/partitions-4mb.csv"

# Logging
CONFIG_LOG_DEFAULT_LEVEL_INFO=y
CONFIG_LOG_DEFAULT_LEVEL=3
```

## sdkconfig.defaults.esp32
```kconfig
# Config for ESP32 with 4MB flash size
CONFIG_ESPTOOLPY_FLASHSIZE_4MB=y
CONFIG_ESPTOOLPY_FLASHSIZE="4MB"
CONFIG_PARTITION_TABLE_CUSTOM_FILENAME="extras/partitions-4mb.csv"
CONFIG_PARTITION_TABLE_FILENAME="extras/partitions-4mb.csv"

# PSRAM
# CONFIG_SPIRAM=y
# CONFIG_SPIRAM_MODE_QUAD=y
```

## sdkconfig.defaults.esp32s3
```kconfig
# Config for ESP32S3 with 8MB flash size
CONFIG_ESPTOOLPY_FLASHSIZE_8MB=y
CONFIG_ESPTOOLPY_FLASHSIZE="8MB"
CONFIG_PARTITION_TABLE_CUSTOM_FILENAME="extras/partitions-8mb.csv"
CONFIG_PARTITION_TABLE_FILENAME="extras/partitions-8mb.csv"

# PSRAM (Octal SPI PSRAM typical for ESP32-S3)
# CONFIG_SPIRAM=y
# CONFIG_SPIRAM_MODE_OCT=y
# CONFIG_SPIRAM_SIZE=8388607
```
